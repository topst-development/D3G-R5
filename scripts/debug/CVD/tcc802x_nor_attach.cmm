//===========================================================================
//
//                       Load Bootlaoder for TCC802x (A7)
//
//                        EDIT HISTORY FOR MODULE
//
//---------------------------------------------------------------------------
// version     who      history
//---------------------------------------------------------------------------
// 160727    Sangwon    Create file
//===========================================================================


sys.cpu CortexA7
sys.config corebase	0x80038000
sys.m.a

if run()
	Break

cd ../../../build/tcc802x
d.load.elf output/boot /RELPATH /PATH ./ /nocode

data.list

enddo
