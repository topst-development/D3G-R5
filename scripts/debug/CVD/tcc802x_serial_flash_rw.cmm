global &image_write_size
global &start_offset
global &sector_addr

&image_write_size=0
&start_offset=0x20000

//---------------------------------------------------------------------------
// DIALOG
//---------------------------------------------------------------------------
WINPOS 5. 15. 44. 5. 0. 0. W001
DIALOG
(
	HEADER "TCC802x Serial Flash Write Script"
	icon ":mmu"

	//-----------------------------------------------------
	// Firmware Image File
	//-----------------------------------------------------
	POS 1. 1. 9. 1.
	TEXT "Image File"

	POS 10. 1. 30. 1.
	IMAGEPATH: EDIT "Select a Image file" ""

	POS 41. 1. 2. 1.
	IMAGEBUTTON: BUTTON "..."
	(
		dialog.setfile IMAGEPATH *
	)

	POS 1. 2.5 42. 2.0
	BT_SET_ENV: BUTTON " Image Write. "
	(
		system.option rb on
		system.option.mmu off
		system.option.enreset off
		system.option.trst on
		system.jtagclock 10mhz

		sys.cpu CortexA7MPCore
		system.config corebase	0x80050000
		SYStem.M attach

		SYStem.MODE Prepare
		D.S EZAHB:0x17000004 %LE %Long 0xffffffff

		SYStem.MODE ATTACH
		if run()
			Break

			
			
		
		&imagefile=dialog.string(IMAGEPATH)

		print "image file: &imagefile"


		R.S R13 0xf000FFF0	; set pc

		print "Serial Flash GPIO Port CFG"
		D.S AZSD:0x0:0x14200430 %LE %Long 0x11111111 
		D.S AZSD:0x0:0x14200434 %LE %Long 0x00000111


		D.S AZSD:0x0:0x1BFF1100 %LE %Long 0x00000000

		//  *(volatile unsigned int *)(SFMC_REG_MODE) = SFMC_REG_MODE_FLASH_RESET;
		D.S AZSD:0x0:0x1B000024 %LE %Long 0x00000001 
		D.S AZSD:0x0:0x1B000028 %LE %Long 0x00040200
		D.S AZSD:0x0:0x1B00002C %LE %Long 0x00000400 

		print "Serial Flash CMD Setting"

		//Set CMD
		D.S AZSD:0x0:0x1B000904 %LE %Long 0x8400009F
		D.S AZSD:0x0:0x1B000908 %LE %Long 0x20004000 
		D.S AZSD:0x0:0x1B00090C %LE %Long 0xF4000000 
		D.S AZSD:0x0:0x1B000910 %LE %Long 0x84000005 
		D.S AZSD:0x0:0x1B000914 %LE %Long 0x20004000 
		D.S AZSD:0x0:0x1B000918 %LE %Long 0xF4000000 
		D.S AZSD:0x0:0x1B00091C %LE %Long 0xA4000006 
		D.S AZSD:0x0:0x1B000920 %LE %Long 0xF4000000 
		D.S AZSD:0x0:0x1B000924 %LE %Long 0x84000004 
		D.S AZSD:0x0:0x1B000928 %LE %Long 0xF4000000 
		D.S AZSD:0x0:0x1B00092C %LE %Long 0xA40000B7 
		D.S AZSD:0x0:0x1B000930 %LE %Long 0xF4000000 
		D.S AZSD:0x0:0x1B000934 %LE %Long 0xA40000B7 
		D.S AZSD:0x0:0x1B000938 %LE %Long 0xF4000000 
		D.S AZSD:0x0:0x1B00093C %LE %Long 0x40002040 
		D.S AZSD:0x0:0x1B000940 %LE %Long 0xF4000000 
		D.S AZSD:0x0:0x1B000944 %LE %Long 0x8B00728D
		D.S AZSD:0x0:0x1B000948 %LE %Long 0x8F000000 
		D.S AZSD:0x0:0x1B00094C %LE %Long 0xAB000000 
		D.S AZSD:0x0:0x1B000950 %LE %Long 0xF4000000 
		D.S AZSD:0x0:0x1B000954 %LE %Long 0x8C720000 
		D.S AZSD:0x0:0x1B000958 %LE %Long 0xAC000001 
		D.S AZSD:0x0:0x1B00095C %LE %Long 0xF4000000 
		D.S AZSD:0x0:0x1B000960 %LE %Long 0x8400000C 
		D.S AZSD:0x0:0x1B000964 %LE %Long 0x48000000 
		D.S AZSD:0x0:0x1B000968 %LE %Long 0x44001000 
		D.S AZSD:0x0:0x1B00096C %LE %Long 0x28000000 
		D.S AZSD:0x0:0x1B000970 %LE %Long 0xF4000000 
		D.S AZSD:0x0:0x1B000974 %LE %Long 0x84000012 
		D.S AZSD:0x0:0x1B000978 %LE %Long 0x40004040 
		D.S AZSD:0x0:0x1B00097C %LE %Long 0x60100000 
		D.S AZSD:0x0:0x1B000980 %LE %Long 0xF4000000 
		D.S AZSD:0x0:0x1B000984 %LE %Long 0x84000020 
		D.S AZSD:0x0:0x1B000988 %LE %Long 0xA4003100 
		D.S AZSD:0x0:0x1B00098C %LE %Long 0xF4000000 
		D.S AZSD:0x0:0x1B000990 %LE %Long 0x840000DC 
		D.S AZSD:0x0:0x1B000994 %LE %Long 0x60004040 
		D.S AZSD:0x0:0x1B000998 %LE %Long 0xF4000000 
		D.S AZSD:0x0:0x1B00099C %LE %Long 0x8400006C 
		D.S AZSD:0x0:0x1B0009A0 %LE %Long 0x48000000 
		D.S AZSD:0x0:0x1B0009A4 %LE %Long 0x44001000 
		D.S AZSD:0x0:0x1B0009A8 %LE %Long 0x2A000000 
		D.S AZSD:0x0:0x1B0009AC %LE %Long 0xF4000000
		// Set CMD end


		// Auto Read mode enable
		D.S AZSD:0x0:0x1B000020 %LE %Long 0x00000960 	// Set CMD_AUTO_ADDR
		D.S AZSD:0x0:0x1B000010 %LE %Long 0x00000010 	// CMD RUN

			
		&imagefile_size=OS.FILE.SIZE(&imagefile)
		
		print "image file size: &imagefile_size byte"

		&sector_size=0x10000

		&erase_count=(&imagefile_size+&start_offset+&sector_size-1)/&sector_size
		&erase_size=&erase_count*&sector_size
		if &imagefile_size>&erase_size
		(
			&erase_count=&erase_count+1
		)
		
		//=======================================================
		//Erase Sector 
		//=======================================================
		print "----------------------------------------"
		print "Erase Sector Num: &erase_count"
		print "----------------------------------------"
		
		&sector_addr=&start_offset

		while &erase_count!=0x0
		(
			//=======================================================
			// Write Enable
			//=======================================================
			print "	+Write Enable"
			print "	"
			D.S AZSD:0x0:0x1B00001C %LE %Long 0x0000091C 	// Set Manual Addr
			D.S AZSD:0x0:0x1B000010 %LE %Long 0x00000001 	// CMD RUN
			&cmd_reg=data.long(R:0x1B000010)
			while &cmd_reg!=0x0
			(
				print %CONTinue "	+"
				&cmd_reg=data.long(R:0x1B000010)
				&cmd_reg=&cmd_reg&0xF
			)
			print "	-Write Enable"
		
			//=======================================================
			// Erase CMD Set
			//=======================================================
			print "	+Erase Sector: &sector_addr"
			print "	"
			D.S AZSD:0x0:0x1B00001C %LE %Long 0x00000990 	// Set Manual Addr
			D.S AZSD:0x0:0x1B000900 %LE %Long &sector_addr	// Set erase Sector addr
			D.S AZSD:0x0:0x1B000010 %LE %Long 0x00000001 	// CMD RUN
			&cmd_reg=data.long(R:0x1B000010)
			while &cmd_reg!=0x0
			(
				print %CONTinue "	+"
				&cmd_reg=data.long(R:0x1B000010)
				&cmd_reg=&cmd_reg&0xF
			)
			print "	-Erase Sector"

			//=======================================================
			// Wait Complete
			//=======================================================			
			print "	+Wait Complete"
			print "	"
			&status=0x1
			while &status!=0x0
			(
				D.S AZSD:0x0:0x1B00001C %LE %Long 0x00000910 	// Set Manual Addr
				D.S AZSD:0x0:0x1B000010 %LE %Long 0x00000001 	// CMD RUN
				&cmd_reg=data.long(R:0x1B000010)
				while &cmd_reg!=0x0
				(
					print %CONTinue "	+"
					&cmd_reg=data.long(R:0x1B000010)
					&cmd_reg=&cmd_reg&0xF
				)
				
				&status=data.long(R:0x1B000800)
				&status=&status&0x1
			)
			print "	-Wait Complete: OK"
			
			&erase_count=&erase_count-1
			&sector_addr=&sector_addr+&sector_size
		)
		
		//=======================================================
		//Write Sector 
		//=======================================================
		&write_size=0x100
		&image_fd_offset=0x0
		&imagetotal_size=&imagefile_size
		&sector_addr=&start_offset
		
		while &imagetotal_size!=0x0
		(
			if &write_size>&imagetotal_size
			(
				&image_write_size=&imagetotal_size
			)
			else
			(
				&image_write_size=&write_size
			)
							
			//=======================================================
			// Write Enable
			//=======================================================
			D.S AZSD:0x0:0x1B00001C %LE %Long 0x0000091C 	// Set Manual Addr
			D.S AZSD:0x0:0x1B000010 %LE %Long 0x00000001 	// CMD RUN
			&cmd_reg=data.long(R:0x1B000010)
			while &cmd_reg!=0x0
			(
				&cmd_reg=data.long(R:0x1B000010)
				&cmd_reg=&cmd_reg&0xF
			)
			
			//=======================================================
			// Write 
			//=======================================================			
			print " +write: &image_write_size byte (remain: &imagetotal_size byte)"
			Data.LOAD.Binary "&imagefile" 0x1B000800++0xFF /skip &image_fd_offset
			
			D.S AZSD:0x0:0x1B00001C %LE %Long 0x00000974 	// Set Manual Addr
			D.S AZSD:0x0:0x1B000900 %LE %Long &sector_addr 	// Sector Addr
			D.S AZSD:0x0:0x1B000010 %LE %Long 0x00000001 	// CMD RUN
			&cmd_reg=data.long(R:0x1B000010)
			while &cmd_reg!=0x0
			(
				&cmd_reg=data.long(R:0x1B000010)
				&cmd_reg=&cmd_reg&0xF
			)
			
			//=======================================================
			// Wait Complete
			//=======================================================			
			&status=0x1
			while &status!=0x0
			(
				D.S AZSD:0x0:0x1B00001C %LE %Long 0x00000910 	// Set Manual Addr
				D.S AZSD:0x0:0x1B000010 %LE %Long 0x00000001 	// CMD RUN
				&cmd_reg=data.long(R:0x1B000010)
				while &cmd_reg!=0x0
				(
					&cmd_reg=data.long(R:0x1B000010)
					&cmd_reg=&cmd_reg&0xF
				)
				
				&status=data.long(R:0x1B000800)
				&status=&status&0x1
			)
			
			&image_fd_offset=&image_fd_offset+&image_write_size
			&imagetotal_size=&imagetotal_size-&image_write_size
			&sector_addr=&sector_addr+&image_write_size
		)
	)
)


