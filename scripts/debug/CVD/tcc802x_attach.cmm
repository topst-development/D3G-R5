//===========================================================================
//
//                       Load Bootlaoder for TCC802x (A7)
//
//                        EDIT HISTORY FOR MODULE
//
//---------------------------------------------------------------------------
// version     who      history
//---------------------------------------------------------------------------
// 160727    Sangwon    Create file
//===========================================================================


system.option rb on
system.option.mmu off
system.option.enreset off
system.option.trst on
system.jtagclock 10mhz

sys.cpu CortexA7
sys.config corebase	0x80038000
sys.m.prepare

D.S EZAHB:0x14400014 %LE %Long 0x02000000
D.A EZAHB:0xF1000000 wfi
D.S EZAHB:0x17000004 %LE %Long 0xFFFFFFFF

sys.m.a

if run()
	Break

print "Serial Flash GPIO Port CFG"
D.S AZSD:0x0:0x14200430 %LE %Long 0x11111111 
D.S AZSD:0x0:0x14200434 %LE %Long 0x00000111


D.S AZSD:0x0:0x1BFF1100 %LE %Long 0x00000000

//  *(volatile unsigned int *)(SFMC_REG_MODE) = SFMC_REG_MODE_FLASH_RESET;
D.S AZSD:0x0:0x1B000024 %LE %Long 0x00000001 

&SFMC_CLK=24.

if &SFMC_CLK==166.
(
	// PERI_SFMC Clk: 166MHz
	D.S AZSD:0x0:0x1B000028 %LE %Long 0x00040430
	D.S AZSD:0x0:0x1B00002C %LE %Long 0x00000500 
)
else
(
	// PERI_SFMC Clk: 24MHz
	D.S AZSD:0x0:0x1B000028 %LE %Long 0x00040200
	D.S AZSD:0x0:0x1B00002C %LE %Long 0x00000400 
)

print "Serial Flash CMD Setting"

//Set CMD
D.S AZSD:0x0:0x1B000904 %LE %Long 0x8400009F
D.S AZSD:0x0:0x1B000908 %LE %Long 0x20004000 
D.S AZSD:0x0:0x1B00090C %LE %Long 0xF4000000 
D.S AZSD:0x0:0x1B000910 %LE %Long 0x84000005 
D.S AZSD:0x0:0x1B000914 %LE %Long 0x20004000 
D.S AZSD:0x0:0x1B000918 %LE %Long 0xF4000000 
D.S AZSD:0x0:0x1B00091C %LE %Long 0xA4000006 
D.S AZSD:0x0:0x1B000920 %LE %Long 0xF4000000 
D.S AZSD:0x0:0x1B000924 %LE %Long 0x84000004 
D.S AZSD:0x0:0x1B000928 %LE %Long 0xF4000000 
D.S AZSD:0x0:0x1B00092C %LE %Long 0xA40000B7 
D.S AZSD:0x0:0x1B000930 %LE %Long 0xF4000000 
D.S AZSD:0x0:0x1B000934 %LE %Long 0xA40000B7 
D.S AZSD:0x0:0x1B000938 %LE %Long 0xF4000000 
D.S AZSD:0x0:0x1B00093C %LE %Long 0x40002040 
D.S AZSD:0x0:0x1B000940 %LE %Long 0xF4000000 
D.S AZSD:0x0:0x1B000944 %LE %Long 0x8B00728D
D.S AZSD:0x0:0x1B000948 %LE %Long 0x8F000000 
D.S AZSD:0x0:0x1B00094C %LE %Long 0xAB000000 
D.S AZSD:0x0:0x1B000950 %LE %Long 0xF4000000 
D.S AZSD:0x0:0x1B000954 %LE %Long 0x8C720000 
D.S AZSD:0x0:0x1B000958 %LE %Long 0xAC000001 
D.S AZSD:0x0:0x1B00095C %LE %Long 0xF4000000 
D.S AZSD:0x0:0x1B000960 %LE %Long 0x8400000C 
D.S AZSD:0x0:0x1B000964 %LE %Long 0x48000000 
D.S AZSD:0x0:0x1B000968 %LE %Long 0x44001000 
D.S AZSD:0x0:0x1B00096C %LE %Long 0x28000000 
D.S AZSD:0x0:0x1B000970 %LE %Long 0xF4000000 
D.S AZSD:0x0:0x1B000974 %LE %Long 0x84000012 
D.S AZSD:0x0:0x1B000978 %LE %Long 0x40004040 
D.S AZSD:0x0:0x1B00097C %LE %Long 0x60100000 
D.S AZSD:0x0:0x1B000980 %LE %Long 0xF4000000 
D.S AZSD:0x0:0x1B000984 %LE %Long 0x84000020 
D.S AZSD:0x0:0x1B000988 %LE %Long 0xA4003100 
D.S AZSD:0x0:0x1B00098C %LE %Long 0xF4000000 
D.S AZSD:0x0:0x1B000990 %LE %Long 0x840000DC 
D.S AZSD:0x0:0x1B000994 %LE %Long 0x60004040 
D.S AZSD:0x0:0x1B000998 %LE %Long 0xF4000000 
D.S AZSD:0x0:0x1B00099C %LE %Long 0x8400006C 
D.S AZSD:0x0:0x1B0009A0 %LE %Long 0x48000000 
D.S AZSD:0x0:0x1B0009A4 %LE %Long 0x44001000 
D.S AZSD:0x0:0x1B0009A8 %LE %Long 0x2A000000 
D.S AZSD:0x0:0x1B0009AC %LE %Long 0xF4000000
// Set CMD end


// Auto Read mode enable
D.S AZSD:0x0:0x1B000020 %LE %Long 0x00000960 	// Set CMD_AUTO_ADDR
D.S AZSD:0x0:0x1B000010 %LE %Long 0x00000010 	// CMD RUN

cd ../../../build/tcc802x
d.load.elf output/boot /RELPATH /PATH ./ /nocode

R.S PC 0xc0020000

data.list

enddo
